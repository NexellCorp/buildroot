## configs/nxp3220_sysv_defconfig
```kconfig
BR2_arm=y
BR2_cortex_a7=y
BR2_ARM_FPU_NEON_VFPV4=y
BR2_SVN=""
BR2_DL_DIR="$(TOPDIR)/../down"
BR2_BACKUP_SITE="http://sources.buildroot.net/"
BR2_KERNEL_MIRROR="http://www.kernel.org/pub/"
BR2_PACKAGE_OVERRIDE_FILE="$(TOPDIR)/local.mk"
BR2_TOOLCHAIN_EXTERNAL=y
BR2_TOOLCHAIN_EXTERNAL_CUSTOM=y
BR2_TOOLCHAIN_EXTERNAL_CUSTOM_PREFIX="arm-linux-gnueabihf"
BR2_TOOLCHAIN_EXTERNAL_GCC_7=y
BR2_TOOLCHAIN_EXTERNAL_HEADERS_4_10=y
BR2_TOOLCHAIN_EXTERNAL_CUSTOM_GLIBC=y
BR2_TOOLCHAIN_EXTERNAL_CXX=y
BR2_TARGET_OPTIMIZATION="-pipe -mno-unaligned-access"
BR2_TARGET_GENERIC_HOSTNAME="Nexell"
BR2_TARGET_GENERIC_ISSUE="Welcome to Nexell"
BR2_ROOTFS_DEVICE_CREATION_DYNAMIC_MDEV=y
BR2_ROOTFS_DEVICE_TABLE=""
BR2_TARGET_TZ_INFO=y
BR2_ROOTFS_POST_IMAGE_SCRIPT="board/nexell/post-image-sysv-nologin.sh"
BR2_PACKAGE_BUSYBOX_CONFIG="board/nexell/busybox.config"
BR2_PACKAGE_ALSA_UTILS=y
BR2_PACKAGE_ALSA_UTILS_ALSACONF=y
BR2_PACKAGE_ALSA_UTILS_ACONNECT=y
BR2_PACKAGE_ALSA_UTILS_ALSALOOP=y
BR2_PACKAGE_ALSA_UTILS_ALSAUCM=y
BR2_PACKAGE_ALSA_UTILS_ALSATPLG=y
BR2_PACKAGE_ALSA_UTILS_AMIDI=y
BR2_PACKAGE_ALSA_UTILS_AMIXER=y
BR2_PACKAGE_ALSA_UTILS_APLAY=y
BR2_PACKAGE_ALSA_UTILS_APLAYMIDI=y
BR2_PACKAGE_ALSA_UTILS_ARECORDMIDI=y
BR2_PACKAGE_ALSA_UTILS_ASEQDUMP=y
BR2_PACKAGE_ALSA_UTILS_ASEQNET=y
BR2_PACKAGE_ALSA_UTILS_BAT=y
BR2_PACKAGE_ALSA_UTILS_IECSET=y
BR2_PACKAGE_ALSA_UTILS_SPEAKER_TEST=y
BR2_PACKAGE_ZIP=y
BR2_PACKAGE_LMBENCH=y
BR2_PACKAGE_MTD=y
BR2_PACKAGE_MTD_JFFS2DUMP=y
BR2_PACKAGE_MTD_MKFSJFFS2=y
BR2_PACKAGE_MTD_MKFSUBIFS=y
BR2_PACKAGE_MTD_MTDPART=y
BR2_PACKAGE_MTOOLS=y
BR2_PACKAGE_GPTFDISK=y
BR2_PACKAGE_LSHW=y
BR2_PACKAGE_MEMTESTER=y
BR2_PACKAGE_PARTED=y
BR2_PACKAGE_TINYALSA=y
BR2_PACKAGE_LIBDRM=y
BR2_PACKAGE_LIBDRM_INSTALL_TESTS=y
BR2_PACKAGE_EXPAT=y
BR2_PACKAGE_READLINE=y
BR2_PACKAGE_CAN_UTILS=y
BR2_PACKAGE_IPERF=y
BR2_PACKAGE_IPUTILS=y
BR2_PACKAGE_ANDROID_TOOLS=y
BR2_PACKAGE_ANDROID_TOOLS_ADB=y
BR2_PACKAGE_ANDROID_TOOLS_ADBD=y
BR2_PACKAGE_UTIL_LINUX_BINARIES=y
BR2_PACKAGE_UTIL_LINUX_FSCK=y
BR2_PACKAGE_UTIL_LINUX_MOUNT=y
BR2_PACKAGE_UTIL_LINUX_NOLOGIN=y
BR2_TARGET_ROOTFS_CPIO=y
# BR2_TARGET_ROOTFS_TAR is not set
```

## package/nexell/Config.in
```kconfig
config BR2_PACKAGE_NEXELL
	bool

choice 
	prompt "Nexell SoCs"

config BR2_PACKAGE_NXP3220
	bool "NXP3220"

endchoice

source "package/nexell/asv-devfs/Config.in"
source "package/nexell/i2stest/Config.in"
source "package/nexell/hwtest/Config.in"
source "package/nexell/vpu/Config.in"
source "package/nexell/library/Config.in"
source "package/nexell/asv-cpu-dvfs/Config.in"
```

## package/nexell/apps/Config.in
```kconfig
menu "Applications"
source "package/nexell/apps/video-api-test/Config.in"
endmenu
```

## package/nexell/apps/video-api-test/Config.in
```kconfig
config BR2_PACKAGE_VIDEO_API_TEST
	bool "video api test"
	select BR2_PACKAGE_LIBDRM
	select BR2_PACKAGE_NX_V4L2
	select BR2_PACKAGE_NX_VIDEO_API
	select BR2_PACKAGE_KERNEL_HEADERS
	help
	  Nexell VIDEO API test applications
```

## package/nexell/apps/video_api_test/Config.in
```kconfig
config BR2_PACKAGE_NEXELL_VIDEO_API_TEST
	bool "video api test"
	select BR2_PACKAGE_LIBDRM
	select BR2_PACKAGE_LIBNX_VIDEO_ALLOC
	select BR2_PACKAGE_LIBNX_VIDEO_API
	depends on BR2_PACKAGE_NXP3220
	help
	  Nexell VIDEO API test applications
```

## package/nexell/asv-cpu-dvfs/Config.in
```kconfig
config BR2_PACKAGE_ASV_CPU_DVFS
	bool "Adaptive Supply Voltage for DVFS"
	depends on BR2_PACKAGE_NXP3220
	help
	  Adaptive Supply Voltage for Generic Dynamic Voltage and Frequency
	  Scaling (DVFS)

if BR2_PACKAGE_ASV_CPU_DVFS
source "package/nexell/asv-cpu-dvfs/asv-cpu-dvfs-main/Config.in"
endif
```

## package/nexell/asv-cpu-dvfs/asv-cpu-dvfs-main/Config.in
```kconfig
config BR2_PACKAGE_ASV_CPU_DVFS_MAIN
	bool "main"
	help
	  Main application for Dynamic Voltage and Frequency Scaling
```

## package/nexell/asv-devfs/Config.in
```kconfig
config BR2_PACKAGE_ASV_DEVFS
	bool "Adaptive Supply Voltage for DEVFS"
	depends on BR2_PACKAGE_NXP3220
	help
	  Adaptive Supply Voltage for Generic Dynamic Voltage and Frequency
	  Scaling (DVFS)

if BR2_PACKAGE_ASV_DEVFS
source "package/nexell/asv-devfs/asv-devfs-main/Config.in"
source "package/nexell/asv-devfs/asv-devfs-vpu/Config.in"
source "package/nexell/asv-devfs/asv-devfs-otg/Config.in"
endif
```

## package/nexell/asv-devfs/asv-devfs-main/Config.in
```kconfig
config BR2_PACKAGE_ASV_DEVFS_MAIN
	bool "main"
	select BR2_PACKAGE_JSON_C
	help
	  Main application for Dynamic Voltage and Frequency Scaling
```

## package/nexell/asv-devfs/asv-devfs-otg/Config.in
```kconfig
config BR2_PACKAGE_ASV_DEVFS_OTG
	bool "otg ums"
	help
	  otg configfs for usb mass stroage
```

## package/nexell/asv-devfs/asv-devfs-vpu/Config.in
```kconfig
config BR2_PACKAGE_ASV_DEVFS_VPU
	bool "vpu test"
	select BR2_PACKAGE_LIBDRM
	select BR2_PACKAGE_LIBNX_VIDEO_ALLOC
	select BR2_PACKAGE_LIBNX_VIDEO_API
	help
	  vpu test application for Dynamic Voltage and Frequency Scaling
```

## package/nexell/disk_test/Config.in
```kconfig
config BR2_PACKAGE_DISK_TEST
	bool "disk test"
	help
	 disk verify and test performance.

config BR2_PACKAGE_DISK_TEST_LOCAL_PATH
	string "source"
	default "../apps/disk_test"
	depends on BR2_PACKAGE_DISK_TEST
```

## package/nexell/hwio/Config.in
```kconfig
config BR2_PACKAGE_HWIO
	bool "hwio"
	help
	 Access to hw io registers

config BR2_PACKAGE_HWIO_LOCAL_PATH
	string "source"
	default "../apps/hwio"
	depends on BR2_PACKAGE_HWIO
```

## package/nexell/hwtest/Config.in
```kconfig
config BR2_PACKAGE_HWTEST
	bool "Hardware Test"
	help
	  Hardware Test applications

if BR2_PACKAGE_HWTEST
source "package/nexell/hwtest/hwtest-disk/Config.in"
source "package/nexell/hwtest/hwtest-eth/Config.in"
endif
```

## package/nexell/hwtest/hwtest-disk/Config.in
```kconfig
config BR2_PACKAGE_HWTEST_DISK
	bool "disk"
	help
	  disk test application for hardware test 
```

## package/nexell/hwtest/hwtest-eth/Config.in
```kconfig
config BR2_PACKAGE_HWTEST_ETH
	bool "eth"
	help
	  ethernet test application for hardware test
```

## package/nexell/i2c_test/Config.in
```kconfig
config BR2_PACKAGE_I2C_TEST
	bool "i2c_test"
	help
	 i2c test.

config BR2_PACKAGE_I2C_TEST_LOCAL_PATH
	string "source"
	default "../apps/i2c_test"
	depends on BR2_PACKAGE_I2C_TEST
```

## package/nexell/i2stest/Config.in
```kconfig
config BR2_PACKAGE_I2STEST
	bool "alsa Test"
	help
	  alsa Test applications

if BR2_PACKAGE_I2STEST
source "package/nexell/i2stest/i2stest-loop/Config.in"
endif
```

## package/nexell/i2stest/i2stest-loop/Config.in
```kconfig
config BR2_PACKAGE_I2STEST_LOOP
	bool "loop"
	help
	  i2s loop test application for alsa test
```

## package/nexell/kernel-headers/Config.in
```kconfig
config BR2_PACKAGE_KERNEL_HEADERS
	bool "install kernel headers"
	help
	  install kernel header files to tools directroy

config BR2_PACKAGE_KERNEL_HEADERS_LOCAL_PATH
	string "path"
	default "../kernel-4.14"
	depends on BR2_PACKAGE_KERNEL_HEADERS
```

## package/nexell/libdirectfb-nexell/Config.in
```kconfig
config BR2_PACKAGE_LIBDIRECTFB_NEXELL
	bool "libdirectfb-nexell"
	select BR2_PACKAGE_LIBDRM
	select BR2_PACKAGE_DIRECTFB
	select BR2_PACKAGE_DIRECTFB_DRMKMS
	select BR2_PACKAGE_KERNEL_HEADERS
	help
	  library for nexell drm memory allocatition.

config BR2_PACKAGE_LIBDIRECTFB_NEXELL_LOCAL_PATH
	string "source"
	default "../library/libdirectfb-nexell"
	depends on BR2_PACKAGE_LIBDIRECTFB_NEXELL
```

## package/nexell/library/Config.in
```kconfig
menu "Librararies"
source "package/nexell/library/nx-v4l2/Config.in"
source "package/nexell/library/nx-drm-allocator/Config.in"
source "package/nexell/library/nx-video-api/Config.in"
endmenu
```

## package/nexell/library/libnx_video_alloc/Config.in
```kconfig
config BR2_PACKAGE_LIBNX_VIDEO_ALLOC
	bool "libnx-video-alloc"
	select BR2_PACKAGE_LIBDRM
	help
	  library for nexell video memory allocatition
```

## package/nexell/library/libnx_video_api/Config.in
```kconfig
config BR2_PACKAGE_LIBNX_VIDEO_API
	bool "libnx-video-api"
	select BR2_PACKAGE_LIBDRM
	select BR2_PACKAGE_LIBNX_VIDEO_ALLOC
	help
	  library for nexell video control api
```

## package/nexell/library/nx-drm-allocator/Config.in
```kconfig
config BR2_PACKAGE_NX_DRM_ALLOCATOR
	bool "drm allocator"
	select BR2_PACKAGE_LIBDRM
	select BR2_PACKAGE_KERNEL_HEADERS
	help
	  library for nexell drm memory allocatition.
```
