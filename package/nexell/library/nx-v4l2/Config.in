## package/nexell/library/nx-v4l2/Config.in
```kconfig
config BR2_PACKAGE_NX_V4L2
	bool "v4l2 api"
	help
	  library for v4l2 wrapper for nexell v4l2 drivers
```

## package/nexell/library/nx-video-api/Config.in
```kconfig
config BR2_PACKAGE_NX_VIDEO_API
	bool "VPU video api"
	select BR2_PACKAGE_LIBDRM
	select BR2_PACKAGE_NX_DRM_ALLOCATOR
	select BR2_PACKAGE_KERNEL_HEADERS
	help
	  library for nexell VPU H/W video api
```

## package/nexell/nx-drm-allocator/Config.in
```kconfig
config BR2_PACKAGE_NX_DRM_ALLOCATOR
	bool "drm allocator"
	select BR2_PACKAGE_LIBDRM
	select BR2_PACKAGE_KERNEL_HEADERS
	help
	  library for nexell drm memory allocatition.

config BR2_PACKAGE_NX_DRM_ALLOCATOR_LOCAL_PATH
	string "source"
	default "../library/nx-drm-allocator"
	depends on BR2_PACKAGE_NX_DRM_ALLOCATOR
```

## package/nexell/nx-v4l2/Config.in
```kconfig
config BR2_PACKAGE_NX_V4L2
	bool "v4l2 api"
	help
	  library for v4l2 wrapper for nexell v4l2 drivers

config BR2_PACKAGE_NX_V4L2_LOCAL_PATH
	string "source"
	default "../library/nx-v4l2"
	depends on BR2_PACKAGE_NX_V4L2
```

## package/nexell/nx-video-api/Config.in
```kconfig
config BR2_PACKAGE_NX_VIDEO_API
	bool "nx-video-api"
	select BR2_PACKAGE_LIBDRM
	select BR2_PACKAGE_NX_DRM_ALLOCATOR
	select BR2_PACKAGE_KERNEL_HEADERS
	help
	  library for nexell VPU H/W video api

config BR2_PACKAGE_NX_VIDEO_API_LOCAL_PATH
	string "source"
	default "../library/nx-video-api"
	depends on BR2_PACKAGE_NX_VIDEO_API
```

## package/nexell/nx_video_api_test/Config.in
```kconfig
config BR2_PACKAGE_NX_VIDEO_API_TEST
	bool "video api test"
	select BR2_PACKAGE_NX_DRM_ALLOCATOR
	select BR2_PACKAGE_NX_VIDEO_API
	select BR2_PACKAGE_NX_V4L2
	select BR2_PACKAGE_FFMPEG
	help
	  Nexell VPU H/W test.

config BR2_PACKAGE_NX_VIDEO_API_TEST_LOCAL_PATH
	string "source"
	default "../apps/nx_video_api_test"
	depends on BR2_PACKAGE_NX_VIDEO_API_TEST
```

## package/nexell/nx_vip_test/Config.in
```kconfig
config BR2_PACKAGE_NX_VIP_TEST
	bool "vip test"
	select BR2_PACKAGE_NX_DRM_ALLOCATOR
	select BR2_PACKAGE_NX_VIDEO_API
	select BR2_PACKAGE_NX_V4L2
	select BR2_PACKAGE_FFMPEG
	help
	  Nexell VIP(Video Input Processor) test.

config BR2_PACKAGE_NX_VIP_TEST_LOCAL_PATH
	string "source"
	default "../apps/nx_vip_test"
	depends on BR2_PACKAGE_NX_VIP_TEST
```

## package/nexell/sleep_rtc_alarm/Config.in
```kconfig
config BR2_PACKAGE_SLEEP_RTC_ALARM
	bool "sleep rtc alarm"
	help
	 sleep rtc alarm.

config BR2_PACKAGE_SLEEP_RTC_ALARM_LOCAL_PATH
	string "source"
	default "../apps/sleep_rtc_alarm"
	depends on BR2_PACKAGE_SLEEP_RTC_ALARM
```

## package/nexell/vpu/Config.in
```kconfig
config BR2_PACKAGE_NEXELL_VPU
	bool "VPU"
	depends on BR2_PACKAGE_NXP3220
	help
	  Nexell VPU test applications

if BR2_PACKAGE_NEXELL_VPU
source "package/nexell/vpu/nexell_vpu_test/Config.in"
endif
```

## package/nexell/vpu/nexell_vpu_test/Config.in
```kconfig
config BR2_PACKAGE_NEXELL_VPU_TEST
	bool "vpu test"
	select BR2_PACKAGE_LIBDRM
	select BR2_PACKAGE_LIBNX_VIDEO_ALLOC
	select BR2_PACKAGE_LIBNX_VIDEO_API
	help
	  Nexell vpu test application
```
